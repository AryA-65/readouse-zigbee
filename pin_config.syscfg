/**
 *
 * @cliArgs --device "CC2340R5RGE" --part "Default" --package "RGE"
 * @versions {"tool":"1.28.1+4785"}
 */

/**
 * These are the peripherals and settings in this configuration
 */
const ADC1                     = scripting.addPeripheral("ADC");
ADC1.$name                     = "VBAT_SENSE";
ADC1.$assign                   = "ADC";
ADC1.PIN1.$used                = false;
ADC1.PIN7.$used                = false;
ADC1.PIN10.$used               = false;
ADC1.PIN11.$assign             = "DIO20_A11";
ADC1.REF_P.$assign             = "DIO6_A1_AR+";
ADC1.ADCTRG.$used              = false;
const GPIO1                    = scripting.addPeripheral("GPIO");
GPIO1["0"].$assign             = "DIO8";
GPIO1.$name                    = "pair_btn";
const GPIO2                    = scripting.addPeripheral("GPIO");
GPIO2.$numPins                 = 2;
GPIO2["0"].$assign             = "DIO12";
GPIO2["1"].$assign             = "DIO13";
GPIO2.$name                    = "LED";
const GPIO3                    = scripting.addPeripheral("GPIO");
GPIO3["0"].$assign             = "DIO24_A7";
GPIO3.$name                    = "calibrate";
const LGPT1                    = scripting.addPeripheral("LGPT");
LGPT1.$name                    = "LED_pair";
LGPT1.$assign                  = "LGPT0";
LGPT1.C0.$assign               = "DIO11";
LGPT1.C1.$used                 = false;
LGPT1.C2.$used                 = false;
LGPT1.C0N.$used                = false;
LGPT1.C1N.$used                = false;
LGPT1.C2N.$used                = false;
LGPT1.F.$used                  = false;
LGPT1.PE.$used                 = false;
const LGPT2                    = scripting.addPeripheral("LGPT");
LGPT2.$name                    = "MOISTURE";
LGPT2.$assign                  = "LGPT1";
LGPT2.C0.$used                 = false;
LGPT2.C1.$assignAllowConflicts = "DIO21_A10";
LGPT2.C1.$used                 = false;
LGPT2.C2.$used                 = false;
LGPT2.C0N.$used                = false;
LGPT2.C1N.$used                = false;
LGPT2.C2N.$used                = false;
LGPT2.F.$used                  = false;
LGPT2.PE.$used                 = false;
const LPC1                     = scripting.addPeripheral("LPC");
LPC1.$name                     = "MOISTURE_comp";
LPC1.$assign                   = "LPC";
LPC1.PLUS.$assign              = "DIO21_A10";
LPC1.MINUS.$used               = false;
LPC1.COMP.$used                = false;
